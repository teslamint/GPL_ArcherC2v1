## build/sysdeps/linux/Config.in
```kconfig
#
# For a description of the syntax of this configuration file,
# see scripts/kbuild/config-language.txt.
#

mainmenu "Lettuce Configuration"

config HAVE_DOT_CONFIG
	bool
	default y

menu "General Configuration"

choice
	prompt "CPU Type"
	default INCLUDE_CPU
	help
	  Choose CPU type

config INCLUDE_CPU_TC3162U
	bool "Ralink TC3162U"

config INCLUDE_CPU_TC3182
	bool "Ralink TC3182"

config INCLUDE_CPU_RTL8672
	bool "Realtek RTL8672"

config INCLUDE_CPU_VR268
	bool "Lantiq VR268"
	
config INCLUDE_CPU_RT63368
	bool "MTK RT63368"
	
config INCLUDE_CPU_RT63365
	bool "MTK RT63365"
	
config INCLUDE_CPU_88F6550 
	bool "Marvell 88F6550" 

config INCLUDE_CPU_MT7620A
	bool "MTK MT7620A"

endchoice
	
config KERNEL_MAX_SIZE 
    string "Kernel bin max size" 
    default "0x110000" 

choice
    prompt "MTD part type" 
    default INCLUDE_MTD_TYPE1 
    help     
      Choose CPU type 
 
config INCLUDE_MTD_TYPE1 
    bool "Default 6 MTD parts" 
 
config INCLUDE_MTD_TYPE2 
    bool "Lantiq 7 MTD parts" 
 
endchoice

choice
	prompt "Product language"
	default INCLUDE_LANGUAGE
	help
	  Choose language type

config INCLUDE_LANGUAGE_CN
	bool "Chinese language"

config INCLUDE_LANGUAGE_EN
	bool "English language"

endchoice

choice
	prompt "ETH Type"
	default INCLUDE_ETH_UNKNOW

config INCLUDE_ETH_LTQ
	bool "Build Lantiq ethernet"
	default n
	
config INCLUDE_ETH_RA
	bool "Build Ralink ethernet"
	default n
endchoice

config INCLUDE_DIGITAL_SIGNATURE
	bool "Digital signature"
	default n
	
config INCLUDE_SOCKET_LOCK
	bool "Use socket mechanism for the data model lock"
	default y if INCLUDE_CPU_TC3182
	default n if !INCLUDE_CPU_TC3182
	help
		semop can not lock the data model well in some platform
	
config INCLUDE_WATCHDOG
	bool "Enable watchdog"
	default n
	
config INCLUDE_SERBIA
	bool "Customized for Serbia"
	depends on INCLUDE_CPU_TC3182
	default n

config INCLUDE_PPA_ACCELERATE
	bool "Enable Lantiq PPA accelerate"
	default n
	
config INCLUDE_CLI_FULL_FEATURE 
	bool "Include all cli cmd"
	default n
	
config INCLUDE_USER_ACCOUNT
	bool "Enable user account,default no need set"
	default n
	
config INCLUDE_CHGINIT_PWD
	bool "Enable change password when init"
	default n

config INCLUDE_AUTH_PASSWORD
	bool "Only auth password"
	depends on INCLUDE_CHGINIT_PWD
	default n
	
config INCLUDE_TEST
	bool "test config by yangxv"
	default n

endmenu

#source archival/Config.in

#
# Wireless options
#
menu 'Wireless Options'

config INCLUDE_LAN_WLAN
	bool "Build wireless"
	default n
	
config INCLUDE_LAN_WLAN_MSSID
	bool "Build wireless Multi-SSID"
	depends on INCLUDE_LAN_WLAN
	default n

config INCLUDE_LAN_WLAN_GUESTNETWORK
	bool "Build wireless GuestNetwork"
	depends on INCLUDE_LAN_WLAN_MSSID
	default n
	
config INCLUDE_LAN_WLAN_WDS
	bool "Build wireless WDS"
	depends on INCLUDE_LAN_WLAN
	default n
	
config INCLUDE_LAN_WLAN_8021X
	bool "Build wireless 802.1x"
	depends on INCLUDE_LAN_WLAN
	default y
	
config INCLUDE_LAN_WLAN_DUALBAND
	bool "Build wlan dual band"
	depends on INCLUDE_LAN_WLAN
        default y	
		
config INCLUDE_LAN_WLAN_DUALBAND_DIF_MAC
	bool "Build Different mac for the second radios"
	depends on INCLUDE_LAN_WLAN
    default y	
	
config INCLUDE_LAN_WLAN_SCHEDULE
	bool "Build wireless schedule"
	depends on INCLUDE_LAN_WLAN
	default n
	
config INCLUDE_LAN_WLAN_SCHEDULE_ONLY_FOR_GUEST
	bool "Build wireless schedule only for guest"
	depends on INCLUDE_LAN_WLAN_SCHEDULE
	default n
	
config INCLUDE_LAN_WLAN_GUEST_TIMEOUT
	bool "Build GuestNetwork timeout"
	depends on INCLUDE_LAN_WLAN_SCHEDULE
	default n
	
config INCLUDE_LAN_WLAN_HWSWITCH
        bool "Build wireless hardware switch"
	depends on INCLUDE_LAN_WLAN
	default n

config INCLUDE_LAN_WLAN_DIFFERENT_CHIP
	bool "Build different wireless chip"
	depends on INCLUDE_LAN_WLAN_DUALBAND
	default n

menu 'WIFI Type'

config INCLUDE_WLAN_RA
	bool "Build Ralink WIFI"
	depends on INCLUDE_LAN_WLAN
	default n
	
config INCLUDE_WLAN_RTL
	bool "Build Realtek WIFI"
	depends on INCLUDE_LAN_WLAN
	default n
	
config INCLUDE_WLAN_ATH
	bool "Build Atheros WIFI"
	depends on INCLUDE_LAN_WLAN
	default n
	
config INCLUDE_WLAN_LQ
	bool "Build LANTIQ WIFI"
	depends on INCLUDE_LAN_WLAN
	default n


config INCLUDE_WLAN_MTK_AC
	bool "Build MTK WIFI(AC)"
	depends on INCLUDE_WLAN_RA
	default n
endmenu
	
endmenu

menu 'DSL Options'

config INCLUDE_ADSLWAN
	bool "Build DSL"
	default n

config INCLUDE_ANNEXB
	bool "Build AnnexB"
	depends on INCLUDE_ADSLWAN
	default n 

choice
	prompt "ADSL Type"
	default INCLUDE_ADSL_UNKNOW
	depends on INCLUDE_ADSLWAN

config INCLUDE_ADSL_RA
	bool "Build Ralink DSL"

config INCLUDE_ADSL_RTL
	bool "Build Realtek DSL"

config INCLUDE_ADSL_LTQ
	bool "Build Lantiq DSL"
	
endchoice

config INCLUDE_AUTO_PVC
	bool "Build auto PVC"
	default n
	
endmenu	# menu 'DSL Options'

menu 'IPv6 Options'
	
config INCLUDE_IPV6
	bool "Build IPv6"
	default n
	
config INCLUDE_IPV6_MLD
	bool "Build IPv6 MLD"
	default n
	depends on INCLUDE_IPV6

config INCLUDE_IPV6_SLAAC
	bool "Build IPv6 WAN SLAAC"
	default n
	depends on INCLUDE_IPV6

config INCLUDE_IPV6_HTTP
	bool "Build IPv6 HTTP & Telnet"
	default n
	depends on INCLUDE_IPV6

endmenu
	
menu 'USB Options'

config INCLUDE_USB
	bool "Build USB"
	default n
	
config INCLUDE_USB_3G_DONGLE
	bool "Build USB 3G dongle"
	default n
	depends on INCLUDE_USB
	
config INCLUDE_USB_OVER_IP
	bool "Build USB over IP"
	default n
	depends on INCLUDE_USB

choice
	prompt "USB over IP Type"
	default INCLUDE_USB_OVER_IP_TPLINK
	depends on INCLUDE_USB_OVER_IP

config INCLUDE_USB_OVER_IP_TPLINK
	bool "Build USB over IP of TP-Link"
	
config INCLUDE_USB_OVER_IP_KCODES
	bool "Build USB over IP of KCodes"
	
endchoice

config INCLUDE_USB_STORAGE
	bool "Build USB storage"
	default n
	depends on INCLUDE_USB
	
config INCLUDE_USB_MEDIA_SERVER
	bool "Build USB DLNA"
	default n
	depends on INCLUDE_USB_STORAGE
	
config INCLUDE_USB_SAMBA_SERVER
	bool "Build USB Samba Server"
	default n
	depends on INCLUDE_USB_STORAGE

config INCLUDE_USB_FTP_SERVER
	bool "Build USB Ftp server"
	default n
	depends on INCLUDE_USB_STORAGE

	
endmenu

menu 'VoIP Options'
	
config INCLUDE_VOIP
	bool "Build VoIP"
	help
	      VOIP Support
	
choice
	prompt "DSP selection"
	depends on INCLUDE_VOIP && (INCLUDE_CPU_TC3182 || INCLUDE_CPU_RT63368)

config INCLUDE_VOIP_WITH_DSP_D2_2S1O
	depends on INCLUDE_VOIP && INCLUDE_CPU_TC3182
	bool "D2 2S1O support"
	def_bool y

config INCLUDE_VOIP_WITH_DSP_MTK
	depends on INCLUDE_VOIP && INCLUDE_CPU_RT63368
	bool "MTK DSP support"
	def_bool y

endchoice

config INCLUDE_DSP_SOCKET_OPEN
	bool "DSP socket open for upper use"
	default n
	help
		We can call setsockopt for the RTP/RTCP socket

config NUM_FXS_CHANNELS
	depends on INCLUDE_VOIP
	int "FxS ports number to be supported"
	range 1 2
	default 2

config INCLUDE_DIGITMAP
	depends on INCLUDE_VOIP
	bool "support digitmap"
	default n
	help
		support digitmap

config INCLUDE_USB_VOICEMAIL
	depends on INCLUDE_USB_STORAGE && INCLUDE_VOIP
	bool "INCLUDE USB VOICEMAIL"
	default y
	help
		support usb voicemail function 

config INCLUDE_USBVM_MODULE
	depends on INCLUDE_USB_VOICEMAIL
	bool "INCLUDE USBVM module"
	default y
	help
		Build a usbvm module for usbvm to play voicemail or voice prompt,the HZ MUST be the multiple of 100
   
config INCLUDE_DMZ
	bool "DMZ Support"
	depends on INCLUDE_VOIP
	default y
	help
		SIP uses it to ADD/DEL nat rule	
   
config INCLUDE_CALLLOG
	bool "Call log Support"
	depends on INCLUDE_VOIP	
	default y
   
config INCLUDE_PSTN
	bool "IAD supports PSTN"
	depends on INCLUDE_VOIP
   
config INCLUDE_PSTN_LIFELINE
	bool "IAD supports PSTN lifeline function"
	depends on INCLUDE_PSTN 
   
config INCLUDE_PSTN_POLREV
	bool "PSTN provides polarity reversal to the FXO port"
	depends on INCLUDE_PSTN 
   
config INCLUDE_PSTN_GATEWAY
	bool "IAD can act as VoIP to PSTN or PSTN to VoIP gateway"
	depends on INCLUDE_PSTN 

menu "VOIP locale support"
	depends on INCLUDE_VOIP
	   
choice
	prompt "Locale selection"
	depends on INCLUDE_VOIP
	
config VOIP_LOCALE_ALL
	bool "SUPPORT all countries"
	      
config VOIP_LOCALE_CUSTOM
	bool "Support customized contries"

endchoice

config VOIP_CFG_AUSTRALIA
	bool "Australia"
	depends on VOIP_LOCALE_CUSTOM

config VOIP_CFG_BELGIUM	
	bool "Belgium"
	depends on VOIP_LOCALE_CUSTOM

config VOIP_CFG_BRAZIL
	bool "Brazil"
	depends on VOIP_LOCALE_CUSTOM

config VOIP_CFG_CANADA
	bool "Canada"
	depends on VOIP_LOCALE_CUSTOM

#config VOIP_CFG_CHILE
#	bool "Chile"
#	depends on VOIP_LOCALE_CUSTOM

config VOIP_CFG_CHINA
	bool "China"
	depends on VOIP_LOCALE_CUSTOM

config VOIP_CFG_COLOMBIA
	bool "Colombia"
	depends on VOIP_LOCALE_CUSTOM

#config VOIP_CFG_CZECH
#	bool "Czech"
#	depends on VOIP_LOCALE_CUSTOM

#config VOIP_CFG_DENMARK
#	bool "Denmark"
#	depends on VOIP_LOCALE_CUSTOM

config VOIP_CFG_ETSI
	bool "ETSI"
	depends on VOIP_LOCALE_CUSTOM

#config VOIP_CFG_FINLAND
#	bool "Finland"
#	depends on VOIP_LOCALE_CUSTOM

config VOIP_CFG_FRANCE
	bool "France"
	depends on VOIP_LOCALE_CUSTOM

config VOIP_CFG_GERMANY
	bool "Germany"
	depends on VOIP_LOCALE_CUSTOM

#config VOIP_CFG_HUNGARY
#	bool "Hungary"
#	depends on VOIP_LOCALE_CUSTOM

config VOIP_CFG_INDIA
	bool "India"
	depends on VOIP_LOCALE_CUSTOM

config VOIP_CFG_INDONESIA
	bool "Indonesia"
	depends on VOIP_LOCALE_CUSTOM

config VOIP_CFG_ITALY
	bool "Italy"
	depends on VOIP_LOCALE_CUSTOM

#config VOIP_CFG_JAPAN
#	bool "Japan"
#	depends on VOIP_LOCALE_CUSTOM

config VOIP_CFG_LATVIA
	bool "Latvia"
	depends on VOIP_LOCALE_CUSTOM

config VOIP_CFG_LITHUANIA
	bool "Lithuania"
	depends on VOIP_LOCALE_CUSTOM

config VOIP_CFG_MEXICO
	bool "Mexico"
	depends on VOIP_LOCALE_CUSTOM

#config VOIP_CFG_NETHERLANDS
#	bool "Netherlands"
#	depends on VOIP_LOCALE_CUSTOM

config VOIP_CFG_NEWZEALAND
	bool "New Zealand"
	depends on VOIP_LOCALE_CUSTOM

config VOIP_CFG_NORTHAMERICA
#	bool "North America"
	def_bool y
	depends on VOIP_LOCALE_CUSTOM

#config VOIP_CFG_NORWAY
#	bool "Norway"
#	depends on VOIP_LOCALE_CUSTOM

config VOIP_CFG_PERU
	bool "Peru"
	depends on VOIP_LOCALE_CUSTOM

config VOIP_CFG_POLAND
	bool "Poland"
	depends on VOIP_LOCALE_CUSTOM

config VOIP_CFG_PORTUGAL
	bool "Portugal"
	depends on VOIP_LOCALE_CUSTOM

config VOIP_CFG_RUSSIA
	bool "Russia"
	depends on VOIP_LOCALE_CUSTOM

config VOIP_CFG_SERBIA
	bool "Serbia"
	depends on VOIP_LOCALE_CUSTOM

config VOIP_CFG_SPAIN
	bool "Spain"
	depends on VOIP_LOCALE_CUSTOM

#config VOIP_CFG_SWEDEN
#	bool "Sweden"
#	depends on VOIP_LOCALE_CUSTOM

#config VOIP_CFG_SWITZERLAND
#	bool "Switzerland"
#	depends on VOIP_LOCALE_CUSTOM

#config VOIP_CFG_TAIWAN
#	bool "Taiwan"
#	depends on VOIP_LOCALE_CUSTOM

config VOIP_CFG_THAILAND
	bool "Thailand"
	depends on VOIP_LOCALE_CUSTOM

config VOIP_CFG_TURKEY
	bool "Turkey"
	depends on VOIP_LOCALE_CUSTOM

config VOIP_CFG_UK
	bool "United Kindom"
	depends on VOIP_LOCALE_CUSTOM

endmenu  # menu "VOIP locale support"

endmenu	# menu 'VoIP Options'


menu 'Function Options'

config INCLUDE_WAN_MODE
	bool "build system mode"
	default y

config INCLUDE_IPPING_DIAG
	bool "build ipping"
	default n
	
config INCLUDE_TRACEROUTE_DIAG
	bool "build traceroute"
	default n
	
config INCLUDE_QOS
	bool "build QoS"
	default n
	
config INCLUDE_E8_APP
	bool "build E8 APP"
	default n
	depends on INCLUDE_QOS
	
config INCLUDE_SSL
	bool "build openSSL"
	default n
	
config INCLUDE_IPSEC
	bool "build IPSec"
	default n

config INCLUDE_CWMP
	bool "build CWMP/TR069"
	default n

config INCLUDE_CWMP_SSL
	bool "build SSL CWMP/TR069"
	default n
	depends on INCLUDE_CWMP && INCLUDE_SSL

config INCLUDE_CWMP_SSL_VERIFY_PEER
	bool "CWMP verify the certification of peer"
	default n
	depends on INCLUDE_CWMP_SSL
	
config INCLUDE_RIP
	bool "Build RIP"
	default n

config INCLUDE_SNMP
	bool "Build SNMP"
	default n

config INCLUDE_DDNS
	bool "Build DDNS"
	default n
	
config INCLUDE_DDNS_PH
	bool "Build oray DDNS"
	default n
	depends on INCLUDE_DDNS
	
config INCLUDE_DYNDNS
	bool "Build dyn DDNS"
	default n
	depends on INCLUDE_DDNS
	
config INCLUDE_NOIPDNS
	bool "Build NO-ip DDNS"
	default n
	depends on INCLUDE_DDNS
	
config INCLUDE_CMXDNS
	bool "Build Comexe DDNS"
	default n
	depends on INCLUDE_DDNS
	
config INCLUDE_IPTV
	bool "Build IPTV"
	default n
	
config INCLUDE_IGMP
	bool "Build IGMP"
	default n

config INCLUDE_ETHERNET_WAN
	bool "Build ethernet WAN"
	default n
	
config INCLUDE_BRIDGING
	bool "Build bridging"
	default n
	
config INCLUDE_ALG
	bool "Build ALG"
	default n
	
config INCLUDE_ALG_H323
	bool "Build H323 ALG"
	default n
	depends on INCLUDE_ALG

config INCLUDE_ALG_SIP
	bool "Build SIP ALG"
	default n
	depends on INCLUDE_ALG
	
config INCLUDE_ROUTE_BINDING
	bool "Build LAN&WAN binding with Policy Route"
	default n
	
config INCLUDE_DUAL_ACCESS
bool "Build PPPoE Dual Access"
	default n
	
config INCLUDE_PPTP
bool "Build PPTP"
	default n
	
config INCLUDE_L2TP
bool "Build L2TP"
	default n

config INCLUDE_ACL
	bool "Build Basic ACL Function(PING ACL)"
	default n

config INCLUDE_ACL_ADVANCE
	bool "Build Full Access Control List Function(Not support yet!!!)"
	default n
	depends on INCLUDE_ACL

config INCLUDE_WAN_TYPE_DETECT
	bool "Build Wan Type Detect"
	default y
	
config INCLUDE_BPA
	bool "Build BigPond Dialing"
	default y
	
endmenu  # menu "Function Options"	

menu 'PON Options'

config INCLUDE_PON
        bool "Build PON"
        default n

config INCLUDE_PON_EPON
        bool "Build PON EPON"
        default n
        depends on INCLUDE_PON

config INCLUDE_PON_GPON
        bool "Build PON GPON"
        default n
        depends on INCLUDE_PON

endmenu

menu 'WEB Options'

config WEB_INCLUDE_MULTI_EWAN
	bool "WEB multi Ethernet WAN"
	default n
		
config WEB_INCLUDE_DST
bool "WEB Daylight Savings Time"
	default n

config INCLUDE_ONLY_ONE_LOGIN
bool "Only one administator can login at the same time"
	default n

endmenu
```

## mtk_ApSoC_4120/linux-2.6.36.x/tpModel/Kconfig
```kconfig
menu "TPLINK Model"

choice
       prompt "TP-LINK Product MODEL"
       default TP_MODEL_C2V1

config TP_MODEL_C20iV1
       bool "Build ArcherC20i V1"

config TP_MODEL_C2V1
       bool "Build ArcherC2 V1"
	   
endchoice


endmenu
```
